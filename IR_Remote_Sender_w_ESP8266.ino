#define SEND D5

int volume_down[67] = { 265, 123, 23, 8, 24, 8, 24, 42, 22, 9, 24, 8, 24,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 42, 23 };
int volume_up[67] = { 267, 122, 23, 8, 24, 8, 24, 41, 24, 8, 24, 8, 24,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 40, 24 };
int one[67] = { 265, 123, 23, 9, 23, 9, 23, 41, 23, 8, 24, 8, 24,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 42, 23 };
int two[67] = { 265, 123, 23, 9, 24, 9, 23, 42, 23, 9, 24, 8, 23,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 42, 22 };
int three[67] = { 264, 125, 20, 9, 23, 10, 23, 43, 21, 9, 23, 9, 23,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 43, 21 };
int four[67] = { 265, 124, 22, 9, 23, 9, 23, 42, 23, 9, 23, 9, 23,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 42, 23 };
int five[67] = { 265, 123, 22, 9, 24, 8, 24, 42, 23, 9, 23, 9, 24,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 42, 22 };
int six[67] = { 266, 123, 23, 9, 24, 8, 23, 41, 23, 9, 23, 9, 24,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 42, 23 };
int seven[67] = { 266, 123, 23, 8, 24, 8, 24, 42, 23, 9, 23, 9, 23,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 41, 23 };
int eight[67] = { 265, 123, 22, 9, 24, 8, 24, 42, 23, 9, 23, 9, 24,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 42, 23 };
int nine[67] = { 265, 124, 22, 9, 23, 9, 23, 42, 22, 9, 24, 9, 23,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 42, 22 };
int zero[67] = { 265, 124, 22, 9, 23, 9, 23, 42, 22, 9, 24, 9, 23,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 42, 22 };
int program_up[67] = { 266, 123, 22, 8, 24, 8, 24, 41, 23, 9, 23, 9, 24,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 42, 23 };
int program_down[67] = { 266, 123, 23, 8, 24, 8, 24, 42, 23, 8, 24, 8, 24,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 41, 23 };
int home[67] = { 266, 123, 22, 8, 24, 8, 24, 41, 23, 8, 24, 8, 24,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 42, 23 };
int mute[67] = { 265, 124, 22, 9, 23, 9, 23, 43, 22, 8, 24, 9, 23,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 42, 22 };
int arrow_up[67] = { 265, 124, 22, 9, 24, 8, 24, 42, 22, 9, 23, 9, 24,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 42, 22 };
int arrow_down[67] = { 264, 125, 21, 9, 23, 9, 23, 43, 22, 9, 23, 9, 24,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 42, 22 };
int arrow_left[67] = { 266, 123, 23, 9, 24, 9, 24, 41, 23, 9, 24, 8, 24,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 41, 23 };
int arrow_right[67] = { 266, 123, 23, 9, 23, 9, 23, 42, 23, 9, 24, 8, 24,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 42, 23 };
int ok[67] = { 262, 126, 20, 10, 22, 10, 22, 44, 20, 10, 22, 10, 22,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 44, 20 };
int list[67] = { 264, 125, 20, 10, 23, 10, 22, 43, 21, 10, 23, 9, 23,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 43, 21 };
int three_dots[67] = { 264, 124, 21, 10, 22, 10, 23, 42, 22, 9, 23, 10, 23,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 9, 23 };
int back[67] = { 264, 125, 21, 9, 23, 9, 23, 43, 21, 10, 23, 9, 23,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 43, 21 };
int exit_button[67] = { 263, 126, 20, 10, 22, 10, 22, 44, 21, 10, 22, 10, 22,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 44, 21 };
int text[67] = { 263, 125, 20, 10, 22, 10, 22, 44, 21, 10, 22, 10, 22,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 44, 20 };
int t_opt[67] = { 263, 125, 20, 10, 22, 10, 22, 44, 21, 10, 22, 10, 22,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 44, 20 };
int netflix[67] = { 263, 126, 20, 10, 22, 10, 22, 44, 21, 10, 22, 10, 22,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 44, 21 };
int amazon[67] = { 262, 127, 19, 10, 22, 10, 22, 44, 20, 10, 22, 10, 22,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 45, 20 };
int rakuten_tv[67] = { 258, 131, 15, 11, 21, 12, 21, 47, 17, 11, 21, 11, 21,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 11, 21 };
int rec[67] = { 264, 125, 21, 10, 23, 9, 23, 43, 21, 10, 23, 10, 23,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 10, 22 };
int katrori[67] = { 262, 127, 19, 10, 22, 10, 22, 44, 20, 10, 22, 10, 22,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 10, 22 };
int skip_backwards[67] = { 260, 129, 17, 11, 21, 11, 21, 46, 18, 11, 21, 11, 22,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 11, 21 };
int play[67] = { 262, 127, 19, 10, 22, 10, 22, 45, 20, 10, 22, 10, 22,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 10, 22 };
int pause[67] = { 261, 127, 18, 10, 22, 11, 22, 45, 19, 10, 22, 11, 22,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 10, 22 };
int skip_forward[67] = { 262, 127, 19, 10, 22, 10, 22, 44, 20, 10, 22, 10, 22,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 10, 22 };
int red[67] = { 264, 125, 21, 9, 23, 9, 23, 43, 22, 9, 23, 10, 23,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 43, 22 };
int green[67] = { 265, 124, 22, 9, 23, 9, 23, 43, 22, 9, 23, 9, 23,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 42, 22 };
int yellow[67] = { 262, 127, 19, 10, 22, 10, 22, 44, 20, 10, 22, 10, 22,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 44, 20 };
int blue[67] = { 265, 124, 22, 9, 23, 9, 23, 42, 22, 9, 23, 9, 23,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 42, 22 };
int power[67] = { 261, 128, 17, 11, 22, 10, 22, 45, 19, 11, 22, 10, 22,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 46, 19 };
int magnifier[67] = { 262, 127, 19, 10, 22, 10, 22, 45, 20, 10, 22, 10, 22,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 45, 19 };
int subtitle[67] = { 262, 127, 19, 10, 22, 10, 22, 45, 20, 10, 22, 10, 22,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 45, 20 };
int settings[67] = { 258, 131, 14, 11, 21, 11, 21, 48, 16, 12, 21, 11, 21,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 48, 16 };
int connection[67] = { 249, 163, 14, 15, 17, 55, 7, 19, 16, 15, 17, 15, 18,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 60, 5 };
int tv_sat[67] = { 261, 127, 19, 10, 22, 10, 22, 45, 20, 10, 22, 10, 22,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 10, 22 };
int ad[67] = { 262, 126, 20, 10, 22, 10, 22, 44, 20, 10, 22, 10, 22,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 10, 22 };
int guide[67] = { 265, 124, 21, 9, 23, 9, 23, 42, 22, 9, 23, 9, 23,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 9, 2 };


uint32_t dly = 25;  // delay in microseconds
int values[67];


void sendCommand(){
  for(unsigned int i = 0; i < 67; i++){

  }
}


void setup() {
  Serial.begin(115200);
  pinMode(SEND, OUTPUT);
}

void loop() {
  if (Serial.available() != 0) {
    String rs = Serial.readString();
    bool send = true;

    if (rs == "volume_down") {
      memcpy(values, volume_down, 67);
    } else if (rs == "volume_up") {
      memcpy(values, volume_up, 67);
    } else if (rs == "one") {
      memcpy(values, one, 67);
    } else if (rs == "two") {
      memcpy(values, two, 67);
    } else if (rs == "three") {
      memcpy(values, three, 67);
    } else if (rs == "four") {
      memcpy(values, four, 67);
    } else if (rs == "five") {
      memcpy(values, five, 67);
    } else if (rs == "six") {
      memcpy(values, six, 67);
    } else if (rs == "seven") {
      memcpy(values, seven, 67);
    } else if (rs == "eight") {
      memcpy(values, eight, 67);
    } else if (rs == "nine") {
      memcpy(values, nine, 67);
    } else if (rs == "zero") {
      memcpy(values, zero, 67);
    } else if (rs == "program_up") {
      memcpy(values, program_up, 67);
    } else if (rs == "program_down") {
      memcpy(values, program_down, 67);
    } else if (rs == "home") {
      memcpy(values, home, 67);
    } else if (rs == "mute") {
      memcpy(values, mute, 67);
    } else if (rs == "arrow_up") {
      memcpy(values, arrow_up, 67);
    } else if (rs == "arrow_down") {
      memcpy(values, arrow_down, 67);
    } else if (rs == "arrow_left") {
      memcpy(values, arrow_left, 67);
    } else if (rs == "arrow_right") {
      memcpy(values, arrow_right, 67);
    } else if (rs == "ok") {
      memcpy(values, ok, 67);
    } else if (rs == "list") {
      memcpy(values, list, 67);
    } else if (rs == "three_dots") {
      memcpy(values, three_dots, 67);
    } else if (rs == "back") {
      memcpy(values, back, 67);
    } else if (rs == "exit_button") {
      memcpy(values, exit_button, 67);
    } else if (rs == "text") {
      memcpy(values, text, 67);
    } else if (rs == "t_opt") {
      memcpy(values, t_opt, 67);
    } else if (rs == "netflix") {
      memcpy(values, netflix, 67);
    } else if (rs == "amazon") {
      memcpy(values, amazon, 67);
    } else if (rs == "rakuten_tv") {
      memcpy(values, rakuten_tv, 67);
    } else if (rs == "rec") {
      memcpy(values, rec, 67);
    } else if (rs == "katrori") {
      memcpy(values, katrori, 67);
    } else if (rs == "skip_backwards") {
      memcpy(values, skip_backwards, 67);
    } else if (rs == "play") {
      memcpy(values, play, 67);
    } else if (rs == "pause") {
      memcpy(values, pause, 67);
    } else if (rs == "skip_forward") {
      memcpy(values, skip_forward, 67);
    } else if (rs == "red") {
      memcpy(values, red, 67);
    } else if (rs == "green") {
      memcpy(values, green, 67);
    } else if (rs == "yellow") {
      memcpy(values, yellow, 67);
    } else if (rs == "blue") {
      memcpy(values, blue, 67);
    } else if (rs == "power") {
      memcpy(values, power, 67);
    } else if (rs == "magnifier") {
      memcpy(values, magnifier, 67);
    } else if (rs == "subtitle") {
      memcpy(values, subtitle, 67);
    } else if (rs == "settings") {
      memcpy(values, settings, 67);
    } else if (rs == "connection") {
      memcpy(values, connection, 67);
    } else if (rs == "tv_sat") {
      memcpy(values, tv_sat, 67);
    } else if (rs == "ad") {
      memcpy(values, ad, 67);
    } else if (rs == "guide") {
      memcpy(values, guide, 67);
    } else {
      send = false;
      Serial.println("Unknown command '" + rs + "'.");
    }

    if (send == true) {
      
    }


  }
  
  
    //wait for data available)
}
